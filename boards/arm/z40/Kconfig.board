## boards/arm/z40/Kconfig.board
```kconfig
# z40 board configuration

# Copyright (c) 2021 Pete Johanson
# SPDX-License-Identifier: MIT

config BOARD_Z40
	bool "Z40"
	depends on SOC_NRF52840_QIAA
```

## boards/arm/z40/Kconfig.defconfig
```kconfig
# Copyright (c) 2020 Pete Johanson
# SPDX-License-Identifier: MIT

if BOARD_Z40

config BOARD
	default "z40"

config ZMK_KEYBOARD_NAME
	default "z40"

if USB

config USB_NRFX
	default y

config USB_DEVICE_STACK
	default y

endif # USB

config BT_CTLR
	default BT

config ZMK_BLE
	default y

config ZMK_USB
	default y

endif # BOARD_Z40
```
